## recipes-kernel/linux/linux-nezha/defconfig
```kconfig
CONFIG_DEFAULT_HOSTNAME="nezha"
# CONFIG_SWAP is not set
# CONFIG_CROSS_MEMORY_ATTACH is not set
CONFIG_NO_HZ_IDLE=y
CONFIG_HIGH_RES_TIMERS=y
CONFIG_PREEMPT=y
CONFIG_EXPERT=y
# CONFIG_SYSFS_SYSCALL is not set
# CONFIG_VM_EVENT_COUNTERS is not set
# CONFIG_SLUB_DEBUG is not set
# CONFIG_COMPAT_BRK is not set
# CONFIG_SLAB_MERGE_DEFAULT is not set
CONFIG_ARCH_SUNXI=y
# CONFIG_RISCV_ERRATA_ALTERNATIVE is not set
# CONFIG_RISCV_ISA_C is not set
# CONFIG_EFI is not set
CONFIG_PM_AUTOSLEEP=y
CONFIG_PM_WAKELOCKS=y
CONFIG_PM_DEBUG=y
CONFIG_PM_ADVANCED_DEBUG=y
CONFIG_PM_TEST_SUSPEND=y
CONFIG_JUMP_LABEL=y
# CONFIG_SECCOMP is not set
# CONFIG_STACKPROTECTOR is not set
# CONFIG_GCC_PLUGINS is not set
# CONFIG_MQ_IOSCHED_DEADLINE is not set
# CONFIG_MQ_IOSCHED_KYBER is not set
# CONFIG_COREDUMP is not set
CONFIG_NET=y
CONFIG_PACKET=y
CONFIG_UNIX=y
CONFIG_INET=y
# CONFIG_INET_DIAG is not set
# CONFIG_IPV6_SIT is not set
# CONFIG_WIRELESS is not set
# CONFIG_ETHTOOL_NETLINK is not set
CONFIG_DEVTMPFS=y
CONFIG_DEVTMPFS_MOUNT=y
# CONFIG_ALLOW_DEV_COREDUMP is not set
CONFIG_MTD=y
CONFIG_MTD_BLOCK=y
CONFIG_MTD_PARTITIONED_MASTER=y
CONFIG_MTD_SPI_NAND=y
CONFIG_MTD_UBI=y
CONFIG_MTD_UBI_FASTMAP=y
CONFIG_MTD_UBI_BLOCK=y
# CONFIG_BLK_DEV is not set
CONFIG_SCSI=y
# CONFIG_SCSI_PROC_FS is not set
CONFIG_BLK_DEV_SD=y
CONFIG_CHR_DEV_SG=y
# CONFIG_BLK_DEV_BSG is not set
CONFIG_SCSI_SCAN_ASYNC=y
# CONFIG_SCSI_LOWLEVEL is not set
CONFIG_NETDEVICES=y
# CONFIG_NET_CORE is not set
# CONFIG_NET_VENDOR_ALACRITECH is not set
# CONFIG_NET_VENDOR_AMAZON is not set
# CONFIG_NET_VENDOR_AQUANTIA is not set
# CONFIG_NET_VENDOR_ARC is not set
# CONFIG_NET_VENDOR_BROADCOM is not set
# CONFIG_NET_VENDOR_CADENCE is not set
# CONFIG_NET_VENDOR_CAVIUM is not set
# CONFIG_NET_VENDOR_CORTINA is not set
# CONFIG_NET_VENDOR_EZCHIP is not set
# CONFIG_NET_VENDOR_GOOGLE is not set
# CONFIG_NET_VENDOR_HUAWEI is not set
# CONFIG_NET_VENDOR_INTEL is not set
# CONFIG_NET_VENDOR_MICROSOFT is not set
# CONFIG_NET_VENDOR_MARVELL is not set
# CONFIG_NET_VENDOR_MELLANOX is not set
# CONFIG_NET_VENDOR_MICREL is not set
# CONFIG_NET_VENDOR_MICROCHIP is not set
# CONFIG_NET_VENDOR_MICROSEMI is not set
# CONFIG_NET_VENDOR_NATSEMI is not set
# CONFIG_NET_VENDOR_NETRONOME is not set
# CONFIG_NET_VENDOR_NI is not set
# CONFIG_NET_VENDOR_PENSANDO is not set
# CONFIG_NET_VENDOR_QUALCOMM is not set
# CONFIG_NET_VENDOR_RENESAS is not set
# CONFIG_NET_VENDOR_ROCKER is not set
# CONFIG_NET_VENDOR_SAMSUNG is not set
# CONFIG_NET_VENDOR_SEEQ is not set
# CONFIG_NET_VENDOR_SOLARFLARE is not set
# CONFIG_NET_VENDOR_SOCIONEXT is not set
CONFIG_STMMAC_ETH=y
# CONFIG_DWMAC_GENERIC is not set
# CONFIG_NET_VENDOR_SYNOPSYS is not set
# CONFIG_NET_VENDOR_VIA is not set
# CONFIG_NET_VENDOR_WIZNET is not set
# CONFIG_NET_VENDOR_XILINX is not set
CONFIG_REALTEK_PHY=y
# CONFIG_USB_NET_DRIVERS is not set
# CONFIG_WLAN is not set
CONFIG_INPUT_EVDEV=y
# CONFIG_KEYBOARD_ATKBD is not set
CONFIG_KEYBOARD_GPIO=y
CONFIG_KEYBOARD_SUN4I_LRADC=y
# CONFIG_INPUT_MOUSE is not set
# CONFIG_SERIO is not set
# CONFIG_VT is not set
# CONFIG_LEGACY_PTYS is not set
# CONFIG_LDISC_AUTOLOAD is not set
CONFIG_SERIAL_8250=y
# CONFIG_SERIAL_8250_DEPRECATED_OPTIONS is not set
CONFIG_SERIAL_8250_CONSOLE=y
CONFIG_SERIAL_8250_NR_UARTS=6
CONFIG_SERIAL_8250_RUNTIME_UARTS=6
CONFIG_SERIAL_8250_DW=y
CONFIG_SERIAL_OF_PLATFORM=y
CONFIG_SERIAL_EARLYCON_RISCV_SBI=y
CONFIG_HVC_RISCV_SBI=y
CONFIG_I2C=y
# CONFIG_I2C_COMPAT is not set
CONFIG_I2C_CHARDEV=y
# CONFIG_I2C_HELPER_AUTO is not set
CONFIG_I2C_MV64XXX=y
CONFIG_SPI=y
CONFIG_SPI_SUN6I=y
CONFIG_SPI_SPIDEV=y
# CONFIG_PTP_1588_CLOCK is not set
CONFIG_PINCTRL=y
CONFIG_GPIO_SYSFS=y
CONFIG_GPIO_PCF857X=y
CONFIG_POWER_SUPPLY=y
CONFIG_THERMAL=y
CONFIG_THERMAL_STATISTICS=y
CONFIG_THERMAL_WRITABLE_TRIPS=y
CONFIG_THERMAL_GOV_BANG_BANG=y
CONFIG_THERMAL_GOV_USER_SPACE=y
CONFIG_CPU_THERMAL=y
CONFIG_THERMAL_EMULATION=y
CONFIG_SUN8I_THERMAL=y
CONFIG_WATCHDOG=y
CONFIG_WATCHDOG_SYSFS=y
CONFIG_SUNXI_WATCHDOG=y
CONFIG_REGULATOR=y
CONFIG_REGULATOR_FIXED_VOLTAGE=y
CONFIG_REGULATOR_PWM=y
CONFIG_SOUND=y
CONFIG_SND=y
CONFIG_SND_HRTIMER=y
CONFIG_SND_DYNAMIC_MINORS=y
# CONFIG_SND_SUPPORT_OLD_API is not set
# CONFIG_SND_DRIVERS is not set
# CONFIG_SND_SPI is not set
CONFIG_SND_USB_AUDIO=y
CONFIG_SND_SOC=y
CONFIG_SND_SUN20I_CODEC=y
CONFIG_SND_SUN4I_I2S=y
CONFIG_SND_SUN4I_SPDIF=y
# CONFIG_USB_HID is not set
CONFIG_USB=y
CONFIG_USB_ANNOUNCE_NEW_DEVICES=y
CONFIG_USB_DYNAMIC_MINORS=y
CONFIG_USB_OTG=y
CONFIG_USB_EHCI_HCD=y
CONFIG_USB_EHCI_HCD_PLATFORM=y
CONFIG_USB_OHCI_HCD=y
CONFIG_USB_OHCI_HCD_PLATFORM=y
CONFIG_USB_STORAGE=y
CONFIG_USB_UAS=y
CONFIG_USB_MUSB_HDRC=y
CONFIG_USB_MUSB_SUNXI=y
CONFIG_USB_SERIAL=y
CONFIG_USB_SERIAL_CH341=y
CONFIG_NOP_USB_XCEIV=y
CONFIG_USB_GADGET=y
CONFIG_USB_ETH=y
# CONFIG_USB_ETH_RNDIS is not set
CONFIG_USB_ETH_EEM=y
CONFIG_MMC=y
CONFIG_MMC_SUNXI=y
CONFIG_NEW_LEDS=y
CONFIG_LEDS_CLASS=y
CONFIG_LEDS_CLASS_MULTICOLOR=y
CONFIG_LEDS_SUN50I_R329=y
CONFIG_LEDS_TRIGGERS=y
CONFIG_LEDS_TRIGGER_TIMER=y
CONFIG_LEDS_TRIGGER_ONESHOT=y
CONFIG_LEDS_TRIGGER_MTD=y
CONFIG_LEDS_TRIGGER_HEARTBEAT=y
CONFIG_LEDS_TRIGGER_CPU=y
CONFIG_LEDS_TRIGGER_ACTIVITY=y
CONFIG_LEDS_TRIGGER_PANIC=y
CONFIG_LEDS_TRIGGER_NETDEV=y
CONFIG_RTC_CLASS=y
CONFIG_DMADEVICES=y
CONFIG_DMA_SUN6I=y
# CONFIG_VIRTIO_MENU is not set
# CONFIG_VHOST_MENU is not set
CONFIG_SUN8I_DE2_CCU=y
CONFIG_HWSPINLOCK=y
CONFIG_HWSPINLOCK_SUN6I=y
CONFIG_MAILBOX=y
CONFIG_SUN50I_IOMMU=y
CONFIG_REMOTEPROC=y
CONFIG_REMOTEPROC_CDEV=y
CONFIG_SUN8I_DSP_REMOTEPROC=y
CONFIG_RPMSG_CHAR=y
CONFIG_RPMSG_VIRTIO=y
CONFIG_PWM=y
CONFIG_PWM_SUN8I_V536=y
CONFIG_PHY_SUN4I_USB=y
CONFIG_NVMEM_SUNXI_SID=y
CONFIG_EXT4_FS=y
# CONFIG_DNOTIFY is not set
CONFIG_FANOTIFY=y
CONFIG_TMPFS=y
CONFIG_TMPFS_XATTR=y
CONFIG_TMPFS_INODE64=y
# CONFIG_MISC_FILESYSTEMS is not set
# CONFIG_NETWORK_FILESYSTEMS is not set
CONFIG_CRYPTO_USER_API_HASH=y
CONFIG_CRYPTO_USER_API_SKCIPHER=y
CONFIG_CRYPTO_USER_API_RNG=y
CONFIG_CRYPTO_USER_API_AEAD=y
# CONFIG_CRYPTO_USER_API_ENABLE_OBSOLETE is not set
CONFIG_CRYPTO_DEV_SUN8I_CE=y
CONFIG_CRYPTO_DEV_SUN8I_CE_HASH=y
CONFIG_CRYPTO_DEV_SUN8I_CE_PRNG=y
CONFIG_CRYPTO_DEV_SUN8I_CE_TRNG=y
CONFIG_PRINTK_TIME=y
# CONFIG_SECTION_MISMATCH_WARN_ONLY is not set
# CONFIG_FRAME_POINTER is not set
CONFIG_VMLINUX_MAP=y
CONFIG_MAGIC_SYSRQ=y
# CONFIG_MAGIC_SYSRQ_SERIAL is not set
CONFIG_DEBUG_FS=y
# CONFIG_DEBUG_MISC is not set
# CONFIG_SCHED_DEBUG is not set
CONFIG_DEBUG_ATOMIC_SLEEP=y
CONFIG_STACKTRACE=y
# CONFIG_RCU_TRACE is not set
# CONFIG_FTRACE is not set
# CONFIG_RUNTIME_TESTING_MENU is not set
```

## wic/ae350-ax45mp-spl.wks
```
# short-description: Create SD card image for AE350 Platform (AX45MP) with U-Boot SPL and OpenSBI (FW_DYNAMIC)

part /boot --source bootimg-partition --ondisk mmcblk0 --fstype=vfat --label boot --active --fixed-size 64M --align 4096
part / --source rootfs --ondisk mmcblk0 --fstype=ext4 --label root --align 4096 --size 64M
```

## wic/beaglev-ahead.wks
```
# short-description: Create SD card image for BeagleV-ahead
bootloader --ptable gpt
part                                                --label empty --part-name empty --align 4096 --size=2M 
part /boot --source bootimg-partition --fstype=ext4 --label boot  --part-name boot  --align 4096 --size=100M
part /     --source rootfs            --fstype=ext4 --label root  --part-name root  --align 4096 --size 1G
```

## wic/freedom-u540-bbl.wks
```
# short-description: Create SD card image for HiFive Unleashed development board

part bbl --source rawcopy --sourceparams="file=bbl.bin" --ondisk mmcblk --align 1 --part-type 2e54b353-1271-4842-806f-e436d6af6985
part / --source rootfs --ondisk mmcblk --fstype=ext4 --label root --align 4096 --size 5G

bootloader --ptable gpt
```

## wic/freedom-u540-opensbi.wks
```
# short-description: Create SD card image for HiFive Unleashed development board

part /boot --source bootimg-partition --ondisk mmcblk0 --fstype=vfat --label boot --active --size=100M --align 4096
part opensbi --source rawcopy --sourceparams="file=fw_payload.bin" --ondisk mmcblk0 --size 32M --align 1 --part-type 2e54b353-1271-4842-806f-e436d6af6985
part / --source rootfs --ondisk mmcblk0 --fstype=ext4 --label root --align 4096 --size 5G

bootloader --ptable gpt
```

## wic/milkv-duo-s-emmc.wks
```
# short-description: Create eMMC image for Milk-V Duo S
#
# Boot chain (eMMC):
#   1. Boot ROM reads fip.bin from boot0 HW partition (2 MB)
#   2. fip.bin contains: FSBL BL2 + DDR init + OpenSBI + U-Boot
#   3. U-Boot loads kernel + DTB from FAT boot partition in user area
#
# Disk layout (user area only):
#   - /boot (FAT32, 32MB) - uImage.fit, default.dtb, uEnv.txt (~5 MB)
#   - / (ext4) - rootfs, expands to fill available space
#
# No raw fip.bin section — boot0 HW partition is used instead,
# maximizing user area for rootfs on the 3.7 GB eMMC.
#
# === Flashing from SD card (booted from SD) ===
#
# Step 1: Configure eMMC boot partition
#   echo 0 > /sys/block/mmcblk1boot0/force_ro
#   mmc bootpart enable 1 1 /dev/mmcblk1
#
# Step 2: Write fip.bin to boot0
#   dd if=/usr/share/milkv-duo-s/fip.bin of=/dev/mmcblk1boot0 bs=4096 conv=fsync
#   cmp -n $(wc -c < /usr/share/milkv-duo-s/fip.bin) \
#       /usr/share/milkv-duo-s/fip.bin /dev/mmcblk1boot0
#
# Step 3: Write this WIC image to eMMC user area
#   gunzip -c <image>.wic.gz | dd of=/dev/mmcblk1 bs=4096 conv=fsync
#
# === PARTITION_CONFIG reference ===
#   0x48 = boot from boot0, boot ACK enabled (production)
#   0x50 = boot from boot1, boot ACK enabled (A/B fallback)
#   0x00 = boot from user area (uses SD-style raw fip.bin layout)

part /boot --source bootimg-partition --ondisk mmcblk0 --fstype=vfat --label boot --active --fixed-size 32M
part / --source rootfs --ondisk mmcblk0 --fstype=ext4 --label root
```

## wic/milkv-duo-s.wks
```
# short-description: Create SD card image for Milk-V Duo S development board
#
# Boot chain (SD):
#   1. Boot ROM reads fip.bin from raw SD sectors (starting at sector 1)
#   2. fip.bin contains: FSBL BL2 + DDR init + OpenSBI + U-Boot
#   3. U-Boot loads kernel + DTB from FAT boot partition
#
# Disk layout:
#   - MBR at sector 0, fip.bin at sector 1 (rawcopy, 1MB)
#   - /boot (FAT32, 64MB) - uImage.fit, default.dtb, uEnv.txt
#   - / (ext4, 256MB) - rootfs
#
# Note: eMMC boot uses the boot0 HW partition for fip.bin, not raw
# user area sectors. eMMC flashing is handled by the application layer.

part fip --source rawcopy --sourceparams="file=fip.bin" --ondisk mmcblk0 --no-table --fixed-size 1M
part /boot --source bootimg-partition --ondisk mmcblk0 --fstype=vfat --label boot --active --fixed-size 64M --align 4096
part / --source rootfs --ondisk mmcblk0 --fstype=ext4 --label root --align 4096 --size 256M
```

## wic/milkv-duo-spinand.wks
```
# short-description: Create NAND image for Milk-V Duo development board

part /boot --source bootimg-partition --ondisk nand0 --fstype=vfat --label boot --active --fixed-size 64M --align 4096
part / --source rootfs --ondisk nand0 --fstype=ext4 --label root --align 4096 --size 128M
part /system --source rootfs --ondisk nand0 --fstype=ext4 --label system --align 4096 --size 256M
part /data --source rootfs --ondisk nand0 --fstype=ext4 --label data --align 4096 --size 512M

# Generate rootfs.spinand, boot.spinand, and system.spinand files
part /rootfs.spinand --source rawcopy --sourceparams="file=rootfs.spinand" --ondisk nand0 --fstype=ext4 --label rootfs --align 4096 --size 128M
part /boot.spinand --source rawcopy --sourceparams="file=boot.spinand" --ondisk nand0 --fstype=ext4 --label boot --align 4096 --size 64M
part /system.spinand --source rawcopy --sourceparams="file=system.spinand" --ondisk nand0 --fstype=ext4 --label system --align 4096 --size 256M
```

## wic/milkv-duo.wks
```
# short-description: Create SD card image for Milk-V Duo development board

part /boot --source bootimg-partition --ondisk mmcblk0 --fstype=vfat --label boot --active --fixed-size 64M --align 4096
part / --source rootfs --ondisk mmcblk0 --fstype=ext4 --label root --align 4096 --size 128M
```

## wic/nezha.wks
```
# short-description: Create SD card image for Nezha Allwinner D1 development board

part boot0 --source rawcopy --sourceparams="file=boot0_sdcard_sun20iw1p1.bin" --offset 16s --ondisk mmcblk0 --no-table

part u-boot --source rawcopy --sourceparams="file=u-boot.toc1" --offset 32800s --ondisk mmcblk0 --no-table

part /boot --source bootimg-partition --ondisk mmcblk0 --fstype=vfat --label boot --align 4096 --fixed-size 64 --active

part /     --source rootfs --ondisk mmcblk0 --fstype=ext4 --label rootfs  --align 4096 --fixed-size 14000 --exclude-path data/
```

## wic/orangepi-r2s-usb.wks
```
# MBR partition table
bootloader --ptable msdos

# Partition 1: boot (kernel, DTB, boot.scr)
part /boot --source bootimg-partition --fstype=vfat --label boot --size 128M --use-uuid --active --align 4096

# Partition 2: rootfs
part / --source rootfs --fstype=ext4 --label root --use-uuid --align 4096
```

## wic/spacemit-k1.wks
```
# SD Card Layout for boards wit the SpacemiT K1 SoC
bootloader --ptable gpt
part fsbl  --offset 128K --fixed-size 256K --fstype=none --source rawcopy --part-name fsbl --sourceparams="file=FSBL.bin"
part uboot --fixed-size 64M   --fstype=none --source rawcopy --part-name uboot --sourceparams="file=boot-bundle.itb"
part /     --ondisk mmcblk0 --fstype=ext4 --label root --source rootfs --use-uuid --align 4096
```

## wic/visionfive2.wks
```
# short-description: Create a bootable SD card image for Starfive Visionfive2 board
# long-description:
# Create a bootable image that can be written onto a SD card using dd for use
# with Starfive Visionfive2 board
# It uses SPL and u-boot
#
# The disk layout used is:
#  - ----- --------- -------------- --------------
# | | SPL | u-boot  |    boot      |    rootfs    |
#  - ----- --------- -------------- --------------
# ^ ^     ^         ^              ^
# | |     |         |              |
# 0 2MiB  4MiB   8MiB          300MiB + rootfs + IMAGE_EXTRA_SPACE
#
part spl --source rawcopy --sourceparams="file=u-boot-spl.bin.normal.out" --part-name spl --offset 4096S --size 2M --part-type 2E54B353-1271-4842-806F-E436D6AF6985

part uboot --source rawcopy --sourceparams="file=visionfive2_fw_payload.img" --part-name uboot --offset 8192S --size 4M --part-type 5B193300-FC78-40CD-8002-E86C45580B47

part /boot --source bootimg-partition --ondisk mmcblk --fstype=vfat --label boot --use-uuid --part-name boot --part-type EBD0A0A2-B9E5-4433-87C0-68B6B72699C7 --align 4096 --size 292M

part /root --source rootfs --ondisk mmcblk --fstype=ext4 --part-name boot --part-type 0FC63DAF-8483-4772-8E79-3D69D8477DE4 --active --label root --align 4096
bootloader  --ptable gpt
```
