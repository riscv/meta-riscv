## conf/distro/include/maintainers.inc
```bitbake
# meta-riscv maintainers file
#
# Please submit any patches against recipes in meta-riscv via pull request.
#
# If you have problems with or questions about a particular recipe, feel free to
# contact the maintainer directly, but please try to do the following first:
#
# - look in the Yocto Project Bugzilla
#   (http://bugzilla.yoctoproject.org/) to see if a problem has
#   already been reported
#
# - look through recent issues, discussions, and pull requests to see if similar
#   issues have been encountered and/or resolved.
#
# The format is as a bitbake variable override for each recipe
#
#	RECIPE_MAINTAINER:pn-<recipe name> = "Full Name <address@domain>"
#
# Please keep this list in alphabetical order using the C locale.
# (e.g. use 'LC_ALL=C sort' to sort the list).
#
RECIPE_MAINTAINER:pn-base-files = "Unassigned <unassigned@yoctoproject.org>"
RECIPE_MAINTAINER:pn-boot-bundle = "Unassigned <unassigned@yoctoproject.org>"
RECIPE_MAINTAINER:pn-clutter-1.0 = "Unassigned <unassigned@yoctoproject.org>"
RECIPE_MAINTAINER:pn-cogl-1.0 = "Unassigned <unassigned@yoctoproject.org>"
RECIPE_MAINTAINER:pn-core-image-minimal-initramfs = "Unassigned <unassigned@yoctoproject.org>"
RECIPE_MAINTAINER:pn-esos-k3 = "Trevor Gamblin <tgamblin@baylibre.com>"
RECIPE_MAINTAINER:pn-firmware-ddr-training-th1520 = "Unassigned <unassigned@yoctoproject.org>"
RECIPE_MAINTAINER:pn-firmware-rcpu-orangepi-k1 = "Unassigned <unassigned@yoctoproject.org>"
RECIPE_MAINTAINER:pn-firmware-th1520 = "Unassigned <unassigned@yoctoproject.org>"
RECIPE_MAINTAINER:pn-gptfdisk = "Unassigned <unassigned@yoctoproject.org>"
RECIPE_MAINTAINER:pn-gstreamer1.0-plugins-bad = "Unassigned <unassigned@yoctoproject.org>"
RECIPE_MAINTAINER:pn-gstreamer1.0-plugins-base = "Unassigned <unassigned@yoctoproject.org>"
RECIPE_MAINTAINER:pn-hss-payload-generator-native = "Unassigned <unassigned@yoctoproject.org>"
RECIPE_MAINTAINER:pn-initramfs-module-install = "Unassigned <unassigned@yoctoproject.org>"
RECIPE_MAINTAINER:pn-jh7110-spl-tool = "Unassigned <unassigned@yoctoproject.org>"
RECIPE_MAINTAINER:pn-jpu-module = "Unassigned <unassigned@yoctoproject.org>"
RECIPE_MAINTAINER:pn-libseccomp = "Unassigned <unassigned@yoctoproject.org>"
RECIPE_MAINTAINER:pn-libsf-codaj12 = "Unassigned <unassigned@yoctoproject.org>"
RECIPE_MAINTAINER:pn-libsf-omxil = "Unassigned <unassigned@yoctoproject.org>"
RECIPE_MAINTAINER:pn-libsf-wave420l = "Unassigned <unassigned@yoctoproject.org>"
RECIPE_MAINTAINER:pn-libsf-wave511 = "Unassigned <unassigned@yoctoproject.org>"
RECIPE_MAINTAINER:pn-libxshmfence = "Unassigned <unassigned@yoctoproject.org>"
RECIPE_MAINTAINER:pn-linux-eswin-ebc77-dev = "Unassigned <unassigned@yoctoproject.org>"
RECIPE_MAINTAINER:pn-linux-firmware-orangepi = "Unassigned <unassigned@yoctoproject.org>"
RECIPE_MAINTAINER:pn-linux-firmware-visionfive2-imggpu = "Unassigned <unassigned@yoctoproject.org>"
RECIPE_MAINTAINER:pn-linux-firmware-visionfive2-wave420l = "Unassigned <unassigned@yoctoproject.org>"
RECIPE_MAINTAINER:pn-linux-firmware-visionfive2-wave511 = "Unassigned <unassigned@yoctoproject.org>"
RECIPE_MAINTAINER:pn-linux-k3 = "Trevor Gamblin <tgamblin@baylibre.com>"
RECIPE_MAINTAINER:pn-linux-mainline = "Trevor Gamblin <tgamblin@baylibre.com>"
RECIPE_MAINTAINER:pn-linux-starfive-dev = "Unassigned <unassigned@yoctoproject.org>"
RECIPE_MAINTAINER:pn-mesa-pvr = "Unassigned <unassigned@yoctoproject.org>"
RECIPE_MAINTAINER:pn-milkv-duo-fsbl = "Unassigned <unassigned@yoctoproject.org>"
RECIPE_MAINTAINER:pn-openocd = "Unassigned <unassigned@yoctoproject.org>"
RECIPE_MAINTAINER:pn-opensbi = "Trevor Gamblin <tgamblin@baylibre.com>"
RECIPE_MAINTAINER:pn-opensbi-k3 = "Trevor Gamblin <tgamblin@baylibre.com>"
RECIPE_MAINTAINER:pn-packagegroup-gnome-desktop = "Unassigned <unassigned@yoctoproject.org>"
RECIPE_MAINTAINER:pn-powervrconf = "Unassigned <unassigned@yoctoproject.org>"
RECIPE_MAINTAINER:pn-python3-pyruvate = "Unassigned <unassigned@yoctoproject.org>"
RECIPE_MAINTAINER:pn-riscv-initramfs-image = "Unassigned <unassigned@yoctoproject.org>"
RECIPE_MAINTAINER:pn-riscv-spike = "Unassigned <unassigned@yoctoproject.org>"
RECIPE_MAINTAINER:pn-rng-tools = "Unassigned <unassigned@yoctoproject.org>"
RECIPE_MAINTAINER:pn-rtl8723ds = "Unassigned <unassigned@yoctoproject.org>"
RECIPE_MAINTAINER:pn-sysvinit-inittab = "Unassigned <unassigned@yoctoproject.org>"
RECIPE_MAINTAINER:pn-u-boot = "Unassigned <unassigned@yoctoproject.org>"
RECIPE_MAINTAINER:pn-u-boot-k3 = "Trevor Gamblin <tgamblin@baylibre.com>"
RECIPE_MAINTAINER:pn-u-boot-milkv-duo = "Unassigned <unassigned@yoctoproject.org>"
RECIPE_MAINTAINER:pn-u-boot-spl-spacemit = "Trevor Gamblin <tgamblin@baylibre.com>"
RECIPE_MAINTAINER:pn-u-boot-starfive = "Unassigned <unassigned@yoctoproject.org>"
RECIPE_MAINTAINER:pn-vdec-module = "Unassigned <unassigned@yoctoproject.org>"
RECIPE_MAINTAINER:pn-venc-module = "Unassigned <unassigned@yoctoproject.org>"
RECIPE_MAINTAINER:pn-visionfive2-pvr-graphics = "Unassigned <unassigned@yoctoproject.org>"
RECIPE_MAINTAINER:pn-weston = "Unassigned <unassigned@yoctoproject.org>"
RECIPE_MAINTAINER:pn-xserver-xf86-config = "Unassigned <unassigned@yoctoproject.org>"
RECIPE_MAINTAINER:pn-xserver-xorg = "Unassigned <unassigned@yoctoproject.org>"
RECIPE_MAINTAINER:pn-xvisor = "Unassigned <unassigned@yoctoproject.org>"
```

## conf/layer.conf
```bitbake
# We have a conf and classes directory, add to BBPATH
BBPATH .= ":${LAYERDIR}"

# Python helpers (e.g. riscv.tune), see lib/riscv
addpylib ${LAYERDIR}/lib riscv

# We have a recipes-* directories, add to BBFILES
BBFILES += "${LAYERDIR}/recipes-*/*/*.bb \
	${LAYERDIR}/recipes-*/*/*.bbappend"

BBFILE_COLLECTIONS += "riscv-layer"
BBFILE_PATTERN_riscv-layer = "^${LAYERDIR}/"
BBFILE_PRIORITY_riscv-layer = "6"

BBFILES_DYNAMIC += " \
    virtualization-layer:${LAYERDIR}/dynamic-layers/virt-layer/*/*/*.bb \
    virtualization-layer:${LAYERDIR}/dynamic-layers/virt-layer/*/*/*.bbappend \
    openembedded-layer:${LAYERDIR}/dynamic-layers/openembedded-layer/*/*/*.bb \
    openembedded-layer:${LAYERDIR}/dynamic-layers/openembedded-layer/*/*/*.bbappend \
    gnome-layer:${LAYERDIR}/dynamic-layers/gnome-layer/*/*/*.bb \
    gnome-layer:${LAYERDIR}/dynamic-layers/gnome-layer/*/*/*.bbappend \
    meta-python:${LAYERDIR}/dynamic-layers/meta-python/*/*/*.bb \
    meta-python:${LAYERDIR}/dynamic-layers/meta-python/*/*/*.bbappend \
    multimedia-layer:${LAYERDIR}/dynamic-layers/multimedia-layer/*/*/*.bb \
    multimedia-layer:${LAYERDIR}/dynamic-layers/multimedia-layer/*/*/*.bbappend \
    \
"

LAYERSERIES_COMPAT_riscv-layer = "blacksail"

LICENSE_PATH += "${LAYERDIR}/licenses"

SIGGEN_EXCLUDERECIPES_ABISAFE += " \
    mesa-pvr \
"
# Use our deprecation warning function
INHERIT += "warn-deprecated-machines"
```

## conf/machine/beaglev-ahead.conf
```bitbake
#@TYPE: Machine
#@NAME: beaglev-ahead
#@SOC: T-Head 1520
#@DESCRIPTION: Machine configuration for the Beagle-V Ahead board

require include/th1520.inc

# Extend the list from riscv-common.inc
MACHINE_FEATURES += "usb wifi bluetooth"

#============================================
# Kernel Configuration
KERNEL_DEVICETREE ?= "thead/th1520-beaglev-ahead.dtb"
#============================================

#============================================
# Uboot Configuration
UBOOT_MACHINE = "th1520_beaglev_ahead_defconfig"
UBOOT_ENV = ""
#============================================

#============================================
# Firmware Configuration
TH1520_TRAINING_FW_SRC = "lpddr4x-3733-singlerank.lua"
#============================================

#============================================
# Image Configuration
IMAGE_BOOT_FILES = " \
    ${KERNEL_IMAGETYPE} \
    th1520-beaglev-ahead.dtb \
    extlinux.conf;extlinux/extlinux.conf \
"
#============================================
```

## conf/machine/beaglev-fire.conf
```bitbake
#@TYPE: Machine
#@NAME: beaglev-fire
#@SOC: Microchip PolarFire SoC
#@DESCRIPTION: Machine configuration for the BeagleBoard BeagleV-Fire

require conf/machine/include/riscv-common.inc

PREFERRED_PROVIDER_virtual/kernel ?= "linux-mainline"
PREFERRED_PROVIDER_virtual/bootloader ?= "u-boot"

RISCV_SBI_FDT = "mpfs-beaglev-fire.dtb"

KERNEL_IMAGETYPE = "Image"
KERNEL_DEVICETREE = "microchip/${RISCV_SBI_FDT}"

UBOOT_MACHINE = "beaglev_fire_defconfig"
UBOOT_ENV_SUFFIX = "scr"

WKS_FILE_DEPENDS:append = " u-boot"

IMAGE_BOOT_FILES = " \
    ${KERNEL_IMAGETYPE} \
    ${RISCV_SBI_FDT} \
    boot.scr \
"

WKS_FILE = "beaglev-fire.wks"
```

## conf/machine/dc-roma-fml13v01.conf
```bitbake
#@TYPE: Machine
#@NAME: dc-roma-fml13v01
#@SOC: StarFive JH7110
#@DESCRIPTION: Machine configuration for the DeepComputing DC-ROMA RISC-V Mainboard (FML13V01)

require include/jh7110-common.inc

PREFERRED_PROVIDER_virtual/kernel:dc-roma-fml13v01 = "linux-mainline"
PREFERRED_PROVIDER_virtual/bootloader:dc-roma-fml13v01 = "u-boot-starfive"

# Intel Wi-Fi 6E AX210 (M.2 module)
MACHINE_ESSENTIAL_EXTRA_RRECOMMENDS += "linux-firmware-iwlwifi-misc"

RISCV_SBI_FDT ?= "jh7110-deepcomputing-fml13v01.dtb"

KERNEL_DEVICETREE ?= "starfive/jh7110-deepcomputing-fml13v01.dtb"
KERNEL_IMAGETYPE = "Image"

UBOOT_MACHINE = "starfive_visionfive2_defconfig"
UBOOT_DTB_BINARY = "starfive_visionfive2.dtb"
UBOOT_ENV = ""
UBOOT_LOADADDRESS = "0x40200000"

KERNEL_CLASSES:append = " kernel-fit-extra-artifacts"
EXTRA_IMAGEDEPENDS += "linux-yocto-fitimage"

WKS_FILE = "dc-roma-fml13v01.wks"
IMAGE_BOOT_FILES = " \
    fitImage;starfiveu.fit \
    vf2_uEnv.txt \
"
```

## conf/machine/include/jh7110-common.inc
```bitbake
#@TYPE: SOC
#@NAME: StarFive JH7110
#@SOC: StarFive JH7110
#@DESCRIPTION: Common config for boards based on the StarFive JH7110

require jh7110.inc

#============================================
# Common Preferred Providers
PREFERRED_PROVIDER_virtual/kernel ?= "linux-starfive-dev"
PREFERRED_PROVIDER_virtual/bootloader ?= "u-boot-starfive"

# The PowerVR & VPU stack only works with linux-starfive-dev, so it is set
# through an override that exists only while that is the kernel.
MACHINEOVERRIDES =. "${@'jh7110-vendor:' if d.getVar('PREFERRED_PROVIDER_virtual/kernel') == 'linux-starfive-dev' else ''}"

PREFERRED_PROVIDER_virtual/libgl:jh7110-vendor ?= "mesa-pvr"
PREFERRED_PROVIDER_virtual/libglx:jh7110-vendor ?= "mesa-pvr"
PREFERRED_PROVIDER_virtual/mesa:jh7110-vendor ?= "mesa-pvr"
PREFERRED_PROVIDER_virtual/libgbm:jh7110-vendor ?= "mesa-pvr"
PREFERRED_PROVIDER_virtual/egl:jh7110-vendor ?= "mesa-pvr"
PREFERRED_PROVIDER_virtual/libgles3:jh7110-vendor ?= "visionfive2-pvr-graphics"
PREFERRED_PROVIDER_virtual/libgles1:jh7110-vendor ?= "visionfive2-pvr-graphics"
PREFERRED_PROVIDER_virtual/libgles2:jh7110-vendor ?= "visionfive2-pvr-graphics"
PREFERRED_PROVIDER_virtual/libomxil:jh7110-vendor ?= "libsf-omxil"
#============================================

#============================================
# Common Machine Configuration
MACHINE_ESSENTIAL_EXTRA_RRECOMMENDS += " \
    kernel-modules \
"
MACHINE_ESSENTIAL_EXTRA_RRECOMMENDS:append:jh7110-vendor = " \
    linux-firmware-visionfive2-imggpu \
    vdec-module \
    venc-module \
    jpu-module \
    visionfive2-pvr-graphics-tools \
"
#============================================

#============================================
# Common Kernel Configuration
KERNEL_MODULE_AUTOLOAD:append:jh7110-vendor = " pvrsrvkm"
#============================================

# opensbi config
RISCV_SBI_FW_TEXT_START = "0x40000000"

#============================================
# Common Uboot Configuration
EXTRA_IMAGEDEPENDS += "virtual/bootloader"
UBOOT_ENTRYPOINT = "0x40200000"
UBOOT_DTB_LOADADDRESS = "0x46000000"
UBOOT_RD_LOADADDRESS = "0x46100000"
UBOOT_DTB = "1"
SPL_BINARY = "spl/u-boot-spl.bin"
SPL_NORMAL_BINARY = "u-boot-spl.bin.normal.out"
#============================================

#============================================
# Common Image Configuration
IMAGE_BOOT_FILES = " \
    fw_payload.bin \
    ${KERNEL_IMAGETYPE} \
    ${RISCV_SBI_FDT}  \
    boot.scr.uimg \
    vf2_uEnv.txt \
"
WKS_FILE ?= "visionfive2.wks"
#============================================
```

## conf/machine/include/riscv/arch-rv32gc.inc
```bitbake
DEFAULTTUNE ?= "riscv32gc"

require conf/machine/include/riscv/arch-riscv-base.inc

AVAILTUNES += "riscv32gc riscv32 riscv32nf"

TUNE_FEATURES:tune-riscv32gc ?= "rv 32 i m a f d c zicsr zifencei"
TUNE_RISCV_PKGARCH:tune-riscv32gc ?= "riscv32imafdc_zicsr_zifencei"
PACKAGE_EXTRA_ARCHS:tune-riscv32gc = "${TUNE_RISCV_PKGARCH:tune-riscv32gc}"

# Compatibility alias so that layers using old tunes don't break
TUNE_FEATURES:tune-riscv32 ?= "${TUNE_FEATURES:tune-riscv32gc}"
TUNE_RISCV_PKGARCH:tune-riscv32 ?= "${TUNE_RISCV_PKGARCH:tune-riscv32gc}"
PACKAGE_EXTRA_ARCHS:tune-riscv32 = "${PACKAGE_EXTRA_ARCHS:tune-riscv32gc}"

# No float
TUNE_FEATURES:tune-riscv32nf ?= "rv 32 i m a c zicsr zifencei"
TUNE_RISCV_PKGARCH:tune-riscv32nf ?= "riscv32imac_zicsr_zifencei"
PACKAGE_EXTRA_ARCHS:tune-riscv32nf = "${TUNE_RISCV_PKGARCH:tune-riscv32nf}"
```

## conf/machine/include/riscv/arch-rva22u64.inc
```bitbake
require conf/machine/include/riscv/arch-rva20u64.inc

# Extensions mandated by the RVA22U64 profile that aren't in arch-rva20u64.inc
TUNEVALID[zic64b] = "Cache block size is 64 bytes extension."
TUNE_RISCV_MARCH .= "${@bb.utils.contains("TUNE_FEATURES", "zic64b", "_zic64b", "", d)}"

TUNEVALID[zicbop] = "Cache-block prefetching extension."
TUNE_RISCV_MARCH .= "${@bb.utils.contains("TUNE_FEATURES", "zicbop", "_zicbop", "", d)}"

TUNEVALID[zicboz] = "Cache-block zeroing extension."
TUNE_RISCV_MARCH .= "${@bb.utils.contains("TUNE_FEATURES", "zicboz", "_zicboz", "", d)}"

TUNEVALID[zihintpause] = "Pause hint extension."
TUNE_RISCV_MARCH .= "${@bb.utils.contains("TUNE_FEATURES", "zihintpause", "_zihintpause", "", d)}"

TUNEVALID[za64rs] = "Reservation set size of at most 64 bytes extension."
TUNE_RISCV_MARCH .= "${@bb.utils.contains("TUNE_FEATURES", "za64rs", "_za64rs", "", d)}"

TUNEVALID[zfhmin] = "Minimal half-precision floating point extension."
TUNE_RISCV_MARCH .= "${@bb.utils.contains("TUNE_FEATURES", "zfhmin", "_zfhmin", "", d)}"

TUNEVALID[zkt] = "Data-independent execution latency extension."
TUNE_RISCV_MARCH .= "${@bb.utils.contains("TUNE_FEATURES", "zkt", "_zkt", "", d)}"
```
