## conf/machine/include/riscv/arch-rva23u64.inc
```bitbake
require conf/machine/include/riscv/arch-rva22u64.inc

# Extensions mandated by the RVA23U64 profile that aren't in arch-rva22u64.inc
TUNEVALID[zicond] = "Conditional zeroing operations extension."
TUNE_RISCV_MARCH .= "${@bb.utils.contains("TUNE_FEATURES", "zicond", "_zicond", "", d)}"

TUNEVALID[zihintntl] = "Non-temporal locality hints extension."
TUNE_RISCV_MARCH .= "${@bb.utils.contains("TUNE_FEATURES", "zihintntl", "_zihintntl", "", d)}"

TUNEVALID[zihpm] = "Hardware performance counters extension."
TUNE_RISCV_MARCH .= "${@bb.utils.contains("TUNE_FEATURES", "zihpm", "_zihpm", "", d)}"

TUNEVALID[zimop] = "May-be-operations extension."
TUNE_RISCV_MARCH .= "${@bb.utils.contains("TUNE_FEATURES", "zimop", "_zimop", "", d)}"

TUNEVALID[zawrs] = "Wait-on-reservation-set instructions extension."
TUNE_RISCV_MARCH .= "${@bb.utils.contains("TUNE_FEATURES", "zawrs", "_zawrs", "", d)}"

TUNEVALID[zfa] = "Additional floating point instructions extension."
TUNE_RISCV_MARCH .= "${@bb.utils.contains("TUNE_FEATURES", "zfa", "_zfa", "", d)}"

TUNEVALID[zcb] = "Extra compressed integer ops extension."
TUNE_RISCV_MARCH .= "${@bb.utils.contains("TUNE_FEATURES", "zcb", "_zcb", "", d)}"

TUNEVALID[zcmop] = "Compressed may-be-ops extension."
TUNE_RISCV_MARCH .= "${@bb.utils.contains("TUNE_FEATURES", "zcmop", "_zcmop", "", d)}"

TUNEVALID[zvbb] = "Vector basic bit-manipulation extension."
TUNE_RISCV_MARCH .= "${@bb.utils.contains("TUNE_FEATURES", "zvbb", "_zvbb", "", d)}"

TUNEVALID[zve32f] = "Embedded vector computation (32-bit integer, 32-bit FP) extension."
TUNE_RISCV_MARCH .= "${@bb.utils.contains("TUNE_FEATURES", "zve32f", "_zve32f", "", d)}"

TUNEVALID[zve32x] = "Embedded vector computation (32-bit integer) extension."
TUNE_RISCV_MARCH .= "${@bb.utils.contains("TUNE_FEATURES", "zve32x", "_zve32x", "", d)}"

TUNEVALID[zve64d] = "Embedded vector computation (64-bit integer, 64-bit FP) extension."
TUNE_RISCV_MARCH .= "${@bb.utils.contains("TUNE_FEATURES", "zve64d", "_zve64d", "", d)}"

TUNEVALID[zve64f] = "Embedded vector computation (64-bit integer, 32-bit FP) extension."
TUNE_RISCV_MARCH .= "${@bb.utils.contains("TUNE_FEATURES", "zve64f", "_zve64f", "", d)}"

TUNEVALID[zve64x] = "Embedded vector computation (64-bit integer) extension."
TUNE_RISCV_MARCH .= "${@bb.utils.contains("TUNE_FEATURES", "zve64x", "_zve64x", "", d)}"

TUNEVALID[zvfhmin] = "Vector half-precision minimal extension."
TUNE_RISCV_MARCH .= "${@bb.utils.contains("TUNE_FEATURES", "zvfhmin", "_zvfhmin", "", d)}"

TUNEVALID[zvkb] = "Vector cryptography bit-manipulation extension."
TUNE_RISCV_MARCH .= "${@bb.utils.contains("TUNE_FEATURES", "zvkb", "_zvkb", "", d)}"

TUNEVALID[zvkt] = "Vector data independent execution latency extension."
TUNE_RISCV_MARCH .= "${@bb.utils.contains("TUNE_FEATURES", "zvkt", "_zvkt", "", d)}"

TUNEVALID[zvl128b] = "Minimum vector length standard extensions (128-bit)."
TUNE_RISCV_MARCH .= "${@bb.utils.contains("TUNE_FEATURES", "zvl128b", "_zvl128b", "", d)}"

TUNEVALID[zvl32b] = "Minimum vector length standard extensions (32-bit)."
TUNE_RISCV_MARCH .= "${@bb.utils.contains("TUNE_FEATURES", "zvl32b", "_zvl32b", "", d)}"

TUNEVALID[zvl64b] = "Minimum vector length standard extensions (64-bit)."
TUNE_RISCV_MARCH .= "${@bb.utils.contains("TUNE_FEATURES", "zvl64b", "_zvl64b", "", d)}"

TUNEVALID[supm] = "User-mode pointer masking extension."
TUNE_RISCV_MARCH .= "${@bb.utils.contains("TUNE_FEATURES", "supm", "_supm", "", d)}"
```

## conf/machine/include/th1520.inc
```bitbake
#@TYPE: SOC
#@NAME: T-Head 1520 SoC
#@SOC: T-Head 1520
#@DESCRIPTION: SOC configuration for the Alibaba T-Head 1520 SoC with 4 Xuantie C910 cores

require riscv-common.inc
require conf/machine/include/soc-family.inc

SOC_FAMILY = "th1520"

WKS_FILE ?= "th1520.wks"
WKS_FILE_DEPENDS:append = " gptfdisk-native u-boot"

# SBI Configuration
unset RISCV_SBI_PAYLOAD

# U-Boot configuration
UBOOT_ENV = ""
UBOOT_EXTLINUX = "1"
UBOOT_EXTLINUX_CONSOLE ?= ""
UBOOT_EXTLINUX_KERNEL_ARGS ?= "ro rootfstype=ext4 rootwait console=ttyS0,115200 earlycon clk_ignore_unused"
UBOOT_EXTLINUX_ROOT ?= "root=/dev/${rootdev}p2"
UBOOT_EXTLINUX_KERNEL_IMAGE ?= "/Image"

# Kernel configuration
KERNEL_IMAGETYPE = "Image"
MACHINE_ESSENTIAL_EXTRA_RRECOMMENDS:append = " kernel-modules"

# Common Preferred Providers
PREFERRED_PROVIDER_virtual/kernel ?= "linux-mainline"
PREFERRED_PROVIDER_virtual/bootloader ?= "u-boot"
EXTRA_IMAGEDEPENDS += "u-boot firmware-th1520"
```

## conf/machine/licheepi-4a.conf
```bitbake
#@TYPE: Machine
#@NAME: licheepi-4a
#@SOC: T-Head 1520
#@DESCRIPTION: Machine configuration for the LicheePi 4A board

require include/th1520.inc

# Extend the list from riscv-common.inc
MACHINE_FEATURES += "wifi bluetooth"

#============================================
# Kernel Configuration
KERNEL_DEVICETREE ?= "thead/th1520-lichee-pi-4a.dtb"
#============================================

#============================================
# Uboot Configuration
UBOOT_MACHINE = "th1520_lpi4a_defconfig"
UBOOT_EXTLINUX_FDT ?= "/th1520-lichee-pi-4a.dtb"
#============================================

#============================================
# Firmware Configuration
MACHINE_ESSENTIAL_EXTRA_RRECOMMENDS += "linux-firmware-powervr linux-firmware-rtl8723"
TH1520_TRAINING_FW_SRC = "lpddr4x-3733-dualrank.lua"
#============================================

#============================================
# Graphics Configuration
DEPENDS:append:pn-mesa = " clang clang-native spirv-llvm-translator spirv-llvm-translator-native"
GALLIUM_DRIVERS:append:pn-mesa = ",zink"
PACKAGECONFIG:append:pn-mesa = " vulkan zink gallium-llvm"
VULKAN_DRIVERS:append:pn-mesa = ",imagination"
#============================================

#============================================
# Image Configuration
WKS_FILE_DEPENDS:append = " firmware-th1520"

IMAGE_BOOT_FILES = " \
    ${KERNEL_IMAGETYPE} \
    th1520-lichee-pi-4a.dtb \
    extlinux.conf;extlinux/extlinux.conf \
    licheepi-4a-aon.elf \
"
#============================================
```

## conf/machine/milkv-duo256m.conf
```bitbake
#@TYPE: Machine
#@NAME: milkv-duo256m
#@SOC: SOPHGO SG2002
#@DESCRIPTION: Machine configuration for Milk-V Duo256M

require conf/machine/include/milkv-duo.inc

UBOOT_MACHINE ?= "milkv_duo_256m_defconfig"

IMAGE_BOOT_FILES ?= "fip.bin uImage.fit"
```
