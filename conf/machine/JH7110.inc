## conf/machine/include/k3-common.inc
```bitbake
#@TYPE: SOC
#@NAME: Spacemit K3
#@SOC: Spacemit K3
#@DESCRIPTION: Common config for boards based on the Spacemit K3

require conf/machine/include/riscv-common.inc

# Preferred versions
PREFERRED_VERSION_linux-k3 ?= "6.18"

PREFERRED_VERSION_u-boot-k3 ?= "2022.10"
UBOOT_MACHINE = "k3_defconfig"

PREFERRED_VERSION_opensbi-k3 ?= "1.4"
#PREFERRED_VERSION_mesa ?= "24.0%"

#============================================
# Common Preferred Providers
PREFERRED_PROVIDER_virtual/kernel ?= "linux-k3-dev"
PREFERRED_PROVIDER_virtual/bootloader ?= "u-boot-k3"
PREFERRED_PROVIDER_opensbi ?= "opensbi-k3"
PREFERRED_PROVIDER_virtual/libgl ?= "mesa-k3"
PREFERRED_PROVIDER_virtual/libglx ?= "mesa-k3"
PREFERRED_PROVIDER_virtual/mesa ?= "mesa-k3"
PREFERRED_PROVIDER_virtual/libgbm ?= "mesa-k3"
PREFERRED_PROVIDER_virtual/egl ?= "mesa-k3"
PREFERRED_PROVIDER_virtual/libgles1 ?= "mesa-k3"
PREFERRED_PROVIDER_virtual/libgles2 ?= "mesa-k3"
PREFERRED_PROVIDER_virtual/libgles3 ?= "mesa-k3"
#============================================

#============================================
# Common Machine Configuration
# Add esos-k3 firmware as image dependency
EXTRA_IMAGEDEPENDS += "esos-k3"
#============================================

#============================================
# Common Kernel Configuration
KERNEL_IMAGETYPE = "Image"
KERNEL_CLASSES = "kernel"
#============================================

#============================================
# Common Image Configuration
WKS_FILE ?= "k3.wks"
IMAGE_FSTYPES = "ext4 wic"
# K3 uses custom bootinfo and bootfs creation (see image-k3.inc)
#============================================

#============================================
# Machine Features
MACHINE_FEATURES:append = "usbhost usbgadget"
#============================================

#============================================
# Serial Console
SERIAL_CONSOLES = "115200;ttyS0"
#============================================
```

## conf/machine/include/milkv-common.inc
```bitbake
#@TYPE: SOC
#@NAME: Sophgo CV18XX/SG200X
#@DESCRIPTION: Common config for Milk-V boards based on Sophgo CV18XX/SG200X SoCs

require conf/machine/include/riscv/tune-riscv.inc

MACHINE_FEATURES = "screen keyboard ext2 ext3 serial"

KERNEL_CLASSES = "kernel"
KERNEL_IMAGETYPE = "Image.gz"

PREFERRED_PROVIDER_virtual/bootloader ?= "u-boot"

SERIAL_CONSOLES = "115200;ttyS0"

IMAGE_FSTYPES += "wic.gz wic.bmap ext4"

## Do not update fstab file when using wic images
WIC_CREATE_EXTRA_ARGS ?= "--no-fstab-update"

# OpenSBI generic platform for T-Head C906
RISCV_SBI_PLAT = "generic"

# Boot chain: FSBL builds BL2 + composes fip.bin (OpenSBI + U-Boot)
EXTRA_IMAGEDEPENDS += "milkv-duo-fsbl"

# Boot partition contents
# fip.bin is also placed raw by WKS rawcopy but must be listed here
# for WIC to find it in the deploy directory
IMAGE_BOOT_FILES ?= " \
                    default.dtb \
                    fip.bin \
                    uEnv.txt \
                    uImage.fit \
                    "
```

## conf/machine/include/nezha-common.inc
```bitbake
#@TYPE: Include
#@NAME: nezha-common
#@DESCRIPTION: Common configuration for Nezhar boards

require riscv-common.inc

#============================================
# Preferred Providers
PREFERRED_PROVIDER_virtual/kernel ?= "linux-allwinnerd1-dev"
PREFERRED_PROVIDER_virtual/bootloader ?= "u-boot-allwinnerd1"
#============================================

#============================================
# Uboot Configuration
KBUILD_DEFCONFIG = "nezha_defconfig"
UBOOT_ENTRYPOINT = "0x40200000"
UBOOT_DTB_LOADADDRESS = "0x4FA00000"
UBOOT_DTB = "1"
#============================================

#============================================
# Image Configuration
WKS_FILE_DEPENDS:append = "u-boot-allwinnerd1"
WKS_FILE ?= "nezha.wks"
EXTRA_IMAGEDEPENDS += "u-boot-allwinnerd1"
#============================================

#============================================
# SBI Configuration
#- This sets u-boot as the default OpenSBI payload
#-- Nezha board uses TOC1 images loaded by SPL and containing U-Boot, DTB, and
#-- OpenSBI so 'RISCV_SBI_PAYLOAD' isn't used.
#-- 'RISCV_SBI_FDT' isn't used because the DTB is loaded from RAM at
#-- ${fdtcontroladdr}
unset RISCV_SBI_PAYLOAD 
#RISCV_SBI_PAYLOAD ?= "u-boot.bin"
#RISCV_SBI_FDT ?= "sun20i-d1-nezha.dtb"
#============================================

#============================================
# Kernel Configuration
#-- 'KERNEL_DEVICETREE' isn't used because the DTB is loaded from RAM
#-- at address ${fdtcontroladdr}
#KERNEL_DEVICETREE ?= "allwinner/sun20i-d1-nezha.dtb"
#============================================
```

## conf/machine/include/qemuriscv.inc
```bitbake
PREFERRED_PROVIDER_virtual/bootloader ?= "u-boot"

require conf/machine/include/qemu.inc
require conf/machine/include/tune-riscv.inc

MACHINE_FEATURES = "screen keyboard ext2 ext3 serial"

KERNEL_IMAGETYPE = "vmlinux"

GDBVERSION = "riscv"

SERIAL_CONSOLES = "115200;ttyS0"

IMAGE_FSTYPES_append = " ext4"

MACHINE_EXTRA_RRECOMMENDS += " kernel-modules"

EXTRA_IMAGEDEPENDS += "riscv-pk"
RISCV_BBL_PAYLOAD ?= "${KERNEL_IMAGETYPE}"

# qemuboot options
QB_KERNEL_CMDLINE_APPEND = "console=ttyS0,115200 console=tty"
QB_MEM = "-m 512"
QB_MACHINE = "-machine virt"
QB_DEFAULT_KERNEL = "bbl"
#QB_SLIRP_OPT = "-netdev user,id=net0,hostfwd=tcp::22222-:22"
QB_OPT_APPEND = "-show-cursor -monitor null"
QB_TAP_OPT = "-netdev tap,id=net0,ifname=@TAP@,script=no,downscript=no"
QB_NETWORK_DEVICE = "-device virtio-net-device,netdev=net0,mac=@MAC@"
QB_ROOTFS_OPT = "-drive id=disk0,file=@ROOTFS@,if=none,format=raw -device virtio-blk-device,drive=disk0"
QB_SERIAL_OPT = "-device virtio-serial-device -chardev null,id=virtcon -device virtconsole,chardev=virtcon"
QB_TCPSERIAL_OPT = " -device virtio-serial-device -chardev socket,id=virtcon,port=@PORT@,host=127.0.0.1 -device virtconsole,chardev=virtcon"

BAD_RECOMMENDATIONS += "\
    libcxx-dev \
    libcxx-staticdev \
    compiler-rt-dev \
    compiler-rt-staticdev \
"

ASSUME_PROVIDED += "\
    libcxx-dev \
    libcxx-staticdev \
    compiler-rt-dev \
    compiler-rt-staticdev \
"
```

## conf/machine/include/riscv-common.inc
```bitbake
#@DESCRIPTION: Machine configuration for the beta BeagleV Starlight board

require conf/machine/include/riscv/tune-riscv.inc

#============================================
# Common Linux Kernel & Uboot Configuration
KERNEL_CLASSES = "kernel-fitimage"
KERNEL_IMAGETYPE = "fitImage"
UBOOT_ENV ?= "boot"
UBOOT_ENV_SUFFIX = "scr.uimg"
#============================================

#============================================
# Common Preferred Versions
PREFERRED_VERSION_openocd-native = "riscv"
PREFERRED_VERSION_openocd = "riscv"
#============================================

#============================================
# Common Image Configuration
EXTRA_IMAGEDEPENDS += "opensbi"
WIC_CREATE_EXTRA_ARGS ?= "--no-fstab-update"
WKS_FILE_DEPENDS ?= " \
    opensbi \
    e2fsprogs-native \
    bmaptool-native \
"
IMAGE_FSTYPES += "wic.gz wic.bmap ext4"
IMAGE_BOOT_FILES ??= " \
    ${KERNEL_IMAGETYPE} \
    boot.scr.uimg \
    uEnv.txt \
"
#============================================

#============================================
# Common Hardware Configuration
SERIAL_CONSOLES = "115200;ttyS0"
MACHINE_FEATURES = "screen keyboard ext2 ext3 serial"
MACHINE_EXTRA_RRECOMMENDS += " kernel-modules"
#============================================

#============================================
# Common SBI Configuration
RISCV_SBI_PLAT = "generic"
RISCV_SBI_PAYLOAD ?= "u-boot.bin"
#============================================
```

## conf/machine/include/visionfive2-common.inc
```bitbake
#@TYPE: Include
#@NAME: visionfive2-common
#@DESCRIPTION: Common configuration for VisionFive 2 boards

require jh7110-common.inc

#============================================
# Common Machine Configuration
MACHINE_ESSENTIAL_EXTRA_RRECOMMENDS += " \
    kernel-modules \
		"
#============================================

MACHINE_FEATURES += "efi"

#============================================
# SBI Configuration
RISCV_SBI_FDT ?= "jh7110-starfive-visionfive-2-v1.3b.dtb"
unset RISCV_SBI_PAYLOAD
#============================================

#============================================
# Kernel Configuration
KERNEL_DEVICETREE ?= "starfive/jh7110-starfive-visionfive-2-v1.3b.dtb"
KERNEL_CLASSES = "kernel"
KERNEL_IMAGETYPE = "Image"
#============================================

#============================================
# Uboot Configuration
UBOOT_DTB = ""
UBOOT_SUFFIX = "itb"
UBOOT_MACHINE = "starfive_visionfive2_defconfig"
UBOOT_DTB_BINARY = "jh7110-starfive-visionfive-2.dtb"
SPL_BINARY = "spl/u-boot-spl.bin.normal.out"
UBOOT_ENV = ""
#============================================

PREFERRED_PROVIDER_virtual/bootloader = "u-boot"
```

## conf/machine/k3-pico-itx.conf
```bitbake
#@TYPE: Machine
#@NAME: K3 Pico-ITX
#@SOC: Spacemit K3
#@DESCRIPTION: Machine configuration for K3 Pico-ITX development board

require conf/machine/include/k3-vendor.inc

KERNEL_DEVICETREE ?= "spacemit/k3-pico-itx.dtb"

IMAGE_BOOT_FILES += " \
        k3-pico-itx.dtb \
	"

MACHINE_EXTRA_RRECOMMENDS += "\
        linux-firmware-rtl8851 \
        linux-firmware-rtl8852 \
        linux-firmware-rtl8922 \
        "
```

## conf/machine/k3.conf
```bitbake
#@TYPE: Machine
#@NAME: K3 Board
#@SOC: Spacemit K3
#@DESCRIPTION: Machine configuration for Spacemit K3 development board

require conf/machine/include/k3-common.inc

# Device tree files - all K3 hardware variants (matches reference bootfs)
KERNEL_DEVICETREE = " \
    spacemit/k3-pico-itx.dtb \
    spacemit/k3_evb.dtb \
    spacemit/k3_evb2-1.dtb \
    spacemit/k3_evb2-2.dtb \
    spacemit/k3_com260.dtb \
    spacemit/k3_com260_ifx.dtb \
    spacemit/k3_com260_kit_v02.dtb \
    spacemit/k3_deb1.dtb \
    spacemit/k3_dc_board.dtb \
    spacemit/k3_gemini_c0.dtb \
    spacemit/k3_gemini_c1.dtb \
    spacemit/k3_fpga_1x1.dtb \
    spacemit/k3_BS01DCMA.dtb \
"
```
