## conf/machine/JH7110.inc
```bitbake
#@TYPE: SOC
#@NAME: StarFive JH7110
#@SOC: StarFive JH7110
#@DESCRIPTION: SOC configuration for the StarFive JH7110

require conf/machine/include/riscv/tune-riscv.inc
require conf/machine/include/soc-family.inc

MACHINE_FEATURES = "screen keyboard ext2 ext3 serial"
SOC_FAMILY = "jh7110"

UBOOT_ENV ?= "boot"
UBOOT_ENV_SUFFIX = "scr.uimg"
PREFERRED_PROVIDER_virtual/kernel ?= "linux-starfive-dev"
PREFERRED_PROVIDER_virtual/bootloader ?= "u-boot-starfive"

PREFERRED_PROVIDER_virtual/libgl ?= "mesa-pvr"
PREFERRED_PROVIDER_virtual/libglx ?= "mesa-pvr"
PREFERRED_PROVIDER_virtual/mesa ?= "mesa-pvr"
PREFERRED_PROVIDER_virtual/libgbm ?= "mesa-pvr"
PREFERRED_PROVIDER_virtual/egl ?= "mesa-pvr"
PREFERRED_PROVIDER_virtual/libgles3 ?= "visionfive2-pvr-graphics"
PREFERRED_PROVIDER_virtual/libgles1 ?= "visionfive2-pvr-graphics"
PREFERRED_PROVIDER_virtual/libgles2 ?= "visionfive2-pvr-graphics"
PREFERRED_PROVIDER_virtual/libomxil ?= "libsf-omxil"

PREFERRED_VERSION_openocd-native = "riscv"
PREFERRED_VERSION_openocd = "riscv"

RISCV_SBI_PLAT = "generic"

## This sets u-boot as the default OpenSBI payload
RISCV_SBI_PAYLOAD ?= "u-boot.bin"

SERIAL_CONSOLES = "115200;ttyS0"

MACHINE_ESSENTIAL_EXTRA_RRECOMMENDS += " \
    kernel-modules \
    linux-firmware-visionfive2-imggpu \
    vdec-module \
    venc-module \
    jpu-module \
    visionfive2-pvr-graphics-tools \
"

KERNEL_MODULE_AUTOLOAD += "pvrsrvkm"

IMAGE_FSTYPES += "wic.gz wic.bmap ext4"

## Do not update fstab file when using wic images
WIC_CREATE_EXTRA_ARGS ?=  "--no-fstab-update"

EXTRA_IMAGEDEPENDS += "u-boot-starfive"

KERNEL_IMAGETYPE ?= "fitImage"
KERNEL_CLASSES = "kernel-fitimage"
UBOOT_ENTRYPOINT = "0x40200000"
UBOOT_DTB_LOADADDRESS = "0x46000000"
UBOOT_RD_LOADADDRESS = "0x46100000"
UBOOT_DTB = "1"

SPL_BINARY = "spl/u-boot-spl.bin"
SPL_NORMAL_BINARY = "u-boot-spl.bin.normal.out"

## wic default support
WKS_FILE_DEPENDS ?= " \
    opensbi \
    e2fsprogs-native \
    bmap-tools-native \
"

IMAGE_BOOT_FILES ?= " \
    fw_payload.bin \
    ${KERNEL_IMAGETYPE} \
    ${RISCV_SBI_FDT}  \
    boot.scr.uimg \
    vf2_uEnv.txt \
"

WKS_FILE ?= "visionfive2.wks"
```

## conf/machine/ae350-ax45mp.conf
```bitbake
#@TYPE: Machine
#@NAME: ae350-ax45mp
#@SOC: AE350 AX45MP
#@DESCRIPTION: Machine configuration for the AE350 Platfrom (AX45MP)

require include/riscv-common.inc

#============================================
# Kernel Configuration
KERNEL_DEVICETREE ?= "andes/ae350_ax45mp.dtb"
#============================================

#============================================
# Preferred Providers
PREFERRED_PROVIDER_virtual/kernel ?= "linux-ae350-ax45mp-dev"
PREFERRED_PROVIDER_virtual/bootloader ?= "u-boot"
#============================================

#============================================
# SBI Configuration
RISCV_SBI_PLAT = "andes/ae350"
RISCV_SBI_FDT ?= "ae350_ax45mp.dtb"
#============================================

#============================================
# Image Configuration
## wic default support
WKS_FILE_DEPENDS:append = "u-boot"
IMAGE_BOOT_FILES:append = " \
    ${RISCV_SBI_FDT} \
    u-boot.itb \
    u-boot-spl.bin \
"
WKS_FILE ?= "ae350-ax45mp-spl.wks"
EXTRA_IMAGEDEPENDS += "u-boot"
#============================================

#============================================
# Uboot Configuration
UBOOT_MACHINE = "ae350_rv64_spl_xip_defconfig"
SPL_BINARY ?= "spl/u-boot-spl.bin"
# U-Boot ITB (FIT image with U-Boot S-mode, OpenSBI FW_DYNAMIC, DTB [from
# U-Boot source code tree])
UBOOT_SUFFIX ?= "itb"
UBOOT_ENTRYPOINT = "0x600000"
UBOOT_DTB_LOADADDRESS = "0x20000000"
#============================================

#============================================
# Other Custom Configuration
SERIAL_CONSOLES = "38400;ttyS0"
#============================================
```

## conf/machine/bananapi-cm6-io.conf
```bitbake
#@TYPE: Machine
#@NAME: bananapi-cm6-io
#@SOC: SpacemiT K1
#@DESCRIPTION: Machine configuration for Banana PI CM6 IO

require conf/machine/include/k1.inc

KERNEL_DEVICETREE ?= "spacemit/k1-bananapi-cm6-io.dtb"

UBOOT_MACHINE = "bananapi-f3_defconfig"
```

## conf/machine/bananapi-f3.conf
```bitbake
#@TYPE: Machine
#@NAME: bananapi-f3
#@SOC: SpacemiT K1
#@DESCRIPTION: Machine configuration for Banana PI F3

require conf/machine/include/k1.inc

KERNEL_DEVICETREE ?= "spacemit/k1-bananapi-f3.dtb"

UBOOT_MACHINE = "bananapi-f3_defconfig"
```

## conf/machine/baremetal-riscv32.conf
```bitbake
#@TYPE: Machine
#@NAME: generic riscv baremetal machine
#@DESCRIPTION: Machine configuration for running a generic riscv32

require include/baremetal-riscv.inc
DEFAULTTUNE = "riscv32"
```

## conf/machine/baremetal-riscv32nf.conf
```bitbake
#@TYPE: Machine
#@NAME: generic riscv32 baremetal machine without floating point instructions
#@DESCRIPTION: Machine configuration for running a generic riscv32 without FP

require include/baremetal-riscv.inc
DEFAULTTUNE = "riscv32nf"
```

## conf/machine/baremetal-riscv64.conf
```bitbake
#@TYPE: Machine
#@NAME: generic riscv64 baremetal machine
#@DESCRIPTION: Machine configuration for running a generic riscv64

require include/baremetal-riscv.inc
DEFAULTTUNE = "riscv64"

# Override the GCCPIE flag to an empty string to support PIE with the elf toolchain
GCCPIE = ""
```

## conf/machine/beaglev-starlight-jh7100.conf
```bitbake
#@TYPE: Machine
#@NAME: beaglev-starlight-jh7100
#@SOC: StarFive JH7100
#@DESCRIPTION: Machine configuration for the beta BeagleV Starlight board

require include/riscv-common.inc

#============================================
# Preferred Providers
PREFERRED_PROVIDER_virtual/kernel ?= "linux-starfive-dev"
PREFERRED_PROVIDER_virtual/bootloader ?= "u-boot-starfive"
#============================================

#============================================
# Uboot Configuration
UBOOT_MACHINE = "starfive_jh7100_beagle_v_smode_defconfig"
UBOOT_ENTRYPOINT = "0x80200000"
UBOOT_DTB_LOADADDRESS = "0x82200000"
UBOOT_DTB = "1"
UBOOT_DTB_BINARY = "starfive_jh7100_beagle_v.dtb"
#============================================

#============================================
# Image Configuration
IMAGE_BOOT_FILES:append = "fw_payload.bin"
WKS_FILE ?= "beaglev.wks"
EXTRA_IMAGEDEPENDS += "u-boot-starfive"
#- Remove uEnv.txt file
#- TODO: This should be tested and check if the board needs a U-boot env script to boot
#-       or the default Uboot board script is enough.
IMAGE_BOOT_FILES:remove = "uEnv.txt"
#============================================

#============================================
# SBI Configuration
#- This sets u-boot as the default OpenSBI payload
RISCV_SBI_FDT ?= "starfive_jh7100_beagle_v.dtb"
#============================================

#============================================
# Machine Configuration
MACHINE_EXTRA_RRECOMMENDS += "linux-firmware-beaglev-bcm43430"
#============================================

#============================================
# Kernel Configuration
KERNEL_DEVICETREE ?= "starfive/jh7100-beaglev-starlight.dtb"
#============================================
```

## conf/machine/eswin-ebc77.conf
```bitbake
#@TYPE: Machine
#@NAME: ESWIN Computing EBC77
#@SOC: ESWIN Computing EIC7700X
#@DESCRIPTION: Machine configuration for ESWIN Computing EBC77 with vendor Linux kernel
#@MAINTAINER: Marcel Ziswiler <marcel@ziswiler.com>

# Extend the list from riscv-common.inc
MACHINE_FEATURES:append = " bluetooth usb wifi"

MACHINE_ESSENTIAL_EXTRA_RRECOMMENDS:append = " bluez5 broadcom-bt-firmware iwd"

require conf/machine/include/riscv/tune-riscv.inc

KERNEL_CLASSES = "kernel"
KERNEL_IMAGETYPE = "Image"

KERNEL_DTB_BASENAME = "eic7700-sbc-a1.dtb"
KERNEL_DEVICETREE ?= "eswin/${KERNEL_DTB_BASENAME}"

PREFERRED_PROVIDER_virtual/kernel ?= "linux-eswin-ebc77-dev"

UBOOT_EXTLINUX = "1"
UBOOT_EXTLINUX_CONSOLE ?= ""
# Latest downstream U-Boot has an additional eswin folder prefix in its
# hard-coded fdtfile
# Work around this by specifying fdtdir without an additional eswin folder
UBOOT_EXTLINUX_FDTDIR ?= "/"
UBOOT_EXTLINUX_KERNEL_ARGS ?= "rootwait"
UBOOT_EXTLINUX_KERNEL_IMAGE ?= "/Image"
UBOOT_EXTLINUX_ROOT ?= "root=PARTUUID=de0b253f-02fb-4d70-ad0e-6742db4a3883"

# There is no upstream U-Boot support for ESWIN EIC770x yet
# We rely on booting downstream U-Boot being present in SPI-NOR flash
# Using QEMU machine for now just to generate uboot-extlinux-config
UBOOT_MACHINE ?= "qemu-riscv64_defconfig"

PREFERRED_PROVIDER_virtual/bootloader ?= "u-boot"

# OpenSBI 1.8 introduced support for ESWIN EIC770x (not really used yet)
RISCV_SBI_PLAT = "generic"

SERIAL_CONSOLES = "115200;ttyS0"

IMAGE_FSTYPES += "wic.xz wic.bmap ext4"

IMAGE_BOOT_FILES = "${KERNEL_IMAGETYPE} \
                    ${KERNEL_DTB_BASENAME};${KERNEL_DEVICETREE} \
                    extlinux.conf;extlinux/extlinux.conf \
"

# Don't include kernels and DTBs in standard images
RRECOMMENDS:${KERNEL_PACKAGE_NAME}-base = ""
MACHINE_ESSENTIAL_EXTRA_RDEPENDS:remove = "kernel-image-image"
# Install kernel modules by default
MACHINE_ESSENTIAL_EXTRA_RRECOMMENDS:append = " kernel-modules"

WIC_CREATE_EXTRA_ARGS ?= "--no-fstab-update"
WKS_FILE ?= "eswin-ebc77.wks"
```

## conf/machine/freedom-u540.conf
```bitbake
#@TYPE: Machine
#@NAME: freedom-u540
#@SOC: Freedom U540
#@DESCRIPTION: Machine configuration for the HiFive Unleashed development board

require include/riscv-common.inc

#============================================
# Preferred Providers
PREFERRED_PROVIDER_virtual/kernel ?= "linux-mainline"
PREFERRED_PROVIDER_virtual/bootloader ?= "u-boot"
#============================================

#============================================
# SBI Configuration
RISCV_SBI_PLAT = "sifive/fu540"
#- This sets u-boot as the default OpenSBI payload
RISCV_SBI_FDT ?= "hifive-unleashed-a00.dtb"
#- This will set the kernel as the OpenSBI payload. This is not recommended,
#-  you can use U-Boot's MMC loading instead.
# RISCV_SBI_PAYLOAD ?= "${KERNEL_IMAGETYPE}-${MACHINE}.bin"
#- Use this to add Microsemi Expansion board support
# RISCV_SBI_FDT ?=  "hifive-unleashed-a00-microsemi.dtb"
#============================================

#============================================
# Kernel Configuration
KERNEL_DEVICETREE ?= "sifive/${RISCV_SBI_FDT}"
SERIAL_CONSOLES = "115200;ttySIF0"
#============================================

#============================================
# Image Configuration
EXTRA_IMAGEDEPENDS += "u-boot"
IMAGE_FSTYPES:remove = "wic.bmap"
IMAGE_BOOT_FILES = " \
    fw_payload.bin \
    fitImage \
    boot.scr.uimg \
"
WKS_FILE ?= "freedom-u540-opensbi.wks"
#============================================

#============================================
# Uboot Configuration
UBOOT_MACHINE = "sifive_unleashed_defconfig"
UBOOT_ENTRYPOINT = "0x80200000"
UBOOT_DTB_LOADADDRESS = "0x82200000"
#- Set this to "mmc-boot" to generate a boot.scr file which should be included
#-  in the boot partition. It will try to load a kernel image by TFTP and if that
#-  fails it will fall back to local images in the boot partition.
UBOOT_ENV ?= "tftp-mmc-boot"
#============================================
```

## conf/machine/include/arch-riscv.inc
```bitbake
# RISCV Architecture definition

DEFAULTTUNE ?= "riscv64"

TUNE_ARCH = "${TUNE_ARCH_tune-${DEFAULTTUNE}}"
TUNE_PKGARCH = "${TUNE_PKGARCH_tune-${DEFAULTTUNE}}"
TUNE_CCARGS .= ""
```

## conf/machine/include/c910.inc
```bitbake
#@TYPE: SOC
#@NAME: Alibaba Xuantie C910
#@SOC: Xuantie C910
#@DESCRIPTION: SOC configuration for the Alibaba Xuantie C910

require riscv-common.inc
require conf/machine/include/soc-family.inc

SOC_FAMILY = "c910"
```

## conf/machine/include/jh7110-vendor.inc
```bitbake
#@TYPE: SOC
#@NAME: StarFive JH7110
#@SOC: StarFive JH7110
#@DESCRIPTION: Common config for boards based on the StarFive JH7110 - vendor repo version

#============================================
# Common Preferred Providers
PREFERRED_PROVIDER_virtual/kernel ?= "linux-starfive-dev"
PREFERRED_PROVIDER_virtual/bootloader ?= "u-boot-starfive"
PREFERRED_PROVIDER_virtual/libgl ?= "mesa-pvr"
PREFERRED_PROVIDER_virtual/libglx ?= "mesa-pvr"
PREFERRED_PROVIDER_virtual/mesa ?= "mesa-pvr"
PREFERRED_PROVIDER_virtual/libgbm ?= "mesa-pvr"
PREFERRED_PROVIDER_virtual/egl ?= "mesa-pvr"
PREFERRED_PROVIDER_virtual/libgles3 ?= "visionfive2-pvr-graphics"
PREFERRED_PROVIDER_virtual/libgles1 ?= "visionfive2-pvr-graphics"
PREFERRED_PROVIDER_virtual/libgles2 ?= "visionfive2-pvr-graphics"
PREFERRED_PROVIDER_virtual/libomxil ?= "libsf-omxil"
#============================================

#============================================
# Common Machine Configuration
MACHINE_ESSENTIAL_EXTRA_RRECOMMENDS += " \
    linux-firmware-visionfive2-imggpu \
    vdec-module \
    venc-module \
    jpu-module \
    visionfive2-pvr-graphics-tools \
"
#============================================

#============================================
# Common Kernel Configuration
KERNEL_MODULE_AUTOLOAD += "pvrsrvkm"
#============================================
```

## conf/machine/include/jh7110.inc
```bitbake
#@TYPE: SOC
#@NAME: StarFive JH7110
#@SOC: StarFive JH7110
#@DESCRIPTION: SOC configuration for the StarFive JH7110

require riscv-common.inc
require conf/machine/include/soc-family.inc

SOC_FAMILY = "jh7110"
```

## conf/machine/include/k1-vendor.inc
```bitbake
#@TYPE: SOC
#@NAME: SpacemiT K1
#@SOC: SpacemiT K1
#@DESCRIPTION: SOC configuration for the SpacemiT K1 SoC - vendor repo version

# This include is ONLY to be used for vendor-tree based builds for K1 platforms
# like the OrangePi RV2 and R2S. For mainline support, rely on k1.inc.

require conf/machine/include/riscv/tune-riscv.inc
require conf/machine/include/soc-family.inc

SOC_FAMILY = "k1"

PREFERRED_PROVIDER_virtual/kernel ?= "linux-orangepi"
PREFERRED_PROVIDER_virtual/bootloader ?= "u-boot-orangepi"

UBOOT_MACHINE = "x1_defconfig"
SPL_BINARY = "spl/u-boot-spl.bin"
UBOOT_ENV = "boot"
UBOOT_ENV_SUFFIX = "scr"

RISCV_SBI_PLAT = "generic"

KERNEL_CLASSES = "kernel"
KERNEL_IMAGETYPE = "Image"

EXTRA_IMAGEDEPENDS += "u-boot-orangepi"

IMAGE_BOOT_FILES += " \
	${UBOOT_ENV}.${UBOOT_ENV_SUFFIX} \
	${KERNEL_IMAGETYPE} \
	initramfs.img"

INITRAMFS_FSTYPES = "cpio.gz"
IMAGE_FSTYPES += "wic.gz wic.bmap ext4"

WIC_CREATE_EXTRA_ARGS ?= "--no-fstab-update"

SERIAL_CONSOLES = "115200;ttyS0"
MACHINE_FEATURES = "screen keyboard ext2 ext3 serial"
```

## conf/machine/include/k1.inc
```bitbake
#@TYPE: SOC
#@NAME: SpacemiT K1
#@SOC: SpacemiT K1
#@DESCRIPTION: SOC configuration for the SpacemiT K1 SoC

require conf/machine/include/riscv/tune-riscv.inc
require conf/machine/include/soc-family.inc

SOC_FAMILY = "k1"

PREFERRED_PROVIDER_virtual/kernel ?= "linux-mainline-k1"
PREFERRED_PROVIDER_virtual/bootloader ?= "u-boot"

KERNEL_DANGLING_FEATURES_WARN_ONLY = "1"

# Try to bring up a selection of physical or virtual serial consoles (copied
# from genericarm64)
SERIAL_CONSOLES ?= "115200;ttyAMA0 115200;hvc0 115200;ttyS0 115200;ttyS1 115200;ttyS2 115200;ttyPS1"

SPL_BINARY = ""

RISCV_SBI_PLAT = "generic"

KERNEL_CLASSES = "kernel"
KERNEL_IMAGETYPE = "Image"

EXTRA_IMAGEDEPENDS += "u-boot-spl-k1 boot-bundle"

IMAGE_FSTYPES += "wic.gz wic.bmap ext4 tar.zst"
IMAGE_CLASSES += " k1-image"

MACHINE_ESSENTIAL_EXTRA_RDEPENDS += "kernel-modules"

WKS_FILE ?= "spacemit-k1.wks"
```
