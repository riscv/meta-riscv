## conf/machine/mangopi-mq-pro.conf
```bitbake
#@TYPE: Machine
#@NAME: mangopi-mq-pro
#@SOC: Allwinner D1
#@DESCRIPTION: Machine configuration for MangoPi MQ Pro

require include/nezha-common.inc

#============================================
# Uboot Configuration
UBOOT_MACHINE = "mangopi_mq_pro_defconfig"
UBOOT_DTB_BINARY ?= "sun20i-d1-mangopi-mq-pro.dtb"
# FIXME 
# TODO Should be changed to
# https://github.com/smaeul/u-boot/commit/528ae9bc6c55edd3ffe642734b4132a8246ea777#diff-7a77df959a917850f0b29cd98afe6c3ca6de627a0c52dd9983cd42fede7a0e34
# once it's is merged into kernel too
# mangopi_mq_pro_defconfig
#============================================

#============================================
# Kernel Configuration
MACHINE_EXTRA_RRECOMMENDS += " kernel-module-rtl8723ds"
# FIXME the license situation of the firmware is unclear at the moment of
# writing this. Once rtl8723ds_fw is properly licensed (ideally put into
# linux-firmware this should be added to MACHINE_EXTRA_RRECOMMENDS:
#			       linux-firmware-rtl8723ds \
# For more details see: 
#     https://bugs.launchpad.net/ubuntu/+source/rtl8723bt-firmware/+bug/1995462
#
KERNEL_MODULE_AUTOLOAD:append = " hci_uart 8723ds "
#============================================

#============================================
# Machine Configuration
MACHINE_FEATURES:append = " wifi bluetooth"
#============================================
```

## conf/machine/milkv-duo-s.conf
```bitbake
#@TYPE: Machine
#@NAME: milkv-duo-s
#@SOC: Sophgo SG2000 / CV1813H
#@DESCRIPTION: Machine configuration for Milk-V Duo S

require conf/machine/include/milkv-common.inc

PREFERRED_PROVIDER_virtual/kernel ?= "linux-milkv-duo-s"
UBOOT_MACHINE ?= "milkv_duo_s_defconfig"
KERNEL_DEVICETREE ?= "sophgo/sg2000-milkv-duo-s.dtb"

WKS_FILE ?= "milkv-duo-s.wks"
# For eMMC boot images: WKS_FILE = "milkv-duo-s-emmc.wks"
# See wic/milkv-duo-s-emmc.wks for flashing instructions.

# Duo S has on-board eMMC
MACHINE_EXTRA_RRECOMMENDS += "mmc-utils"

# Opt-in features that change kernel config, DTS, or installed packages
# Users enable in local.conf: MACHINE_FEATURES:append = " wifi"
# Available: wifi, bluetooth
```

## conf/machine/milkv-megrez.conf
```bitbake
#@TYPE: Machine
#@NAME: milkv-megrez
#@SOC: ESWIN EIC7700X
#@DESCRIPTION: Machine configuration for Milk-V Megrez

require conf/machine/include/riscv/tune-riscv.inc

MACHINE_FEATURES = "screen keyboard ext2 ext3 serial"

KERNEL_CLASSES = "kernel"
KERNEL_IMAGETYPE = "Image"

KERNEL_DTB_BASENAME = "eic7700-milkv-megrez.dtb"
KERNEL_DEVICETREE ?= "eswin/${KERNEL_DTB_BASENAME}"

PREFERRED_PROVIDER_virtual/kernel ?= "linux-milkv-megrez-dev"

SERIAL_CONSOLES = "115200;ttyS0"

IMAGE_FSTYPES += "wic wic.gz wic.bmap ext4"

IMAGE_BOOT_FILES = "${KERNEL_IMAGETYPE} \
                    ${KERNEL_DTB_BASENAME};${KERNEL_DEVICETREE} \
"

WIC_CREATE_EXTRA_ARGS ?= "--no-fstab-update"
WKS_FILE ?= "milkv-megrez.wks"
```

## conf/machine/muse-pi-pro.conf
```bitbake
#@TYPE: Machine
#@NAME: muse-pi-pro
#@SOC: SpacemiT K1
#@DESCRIPTION: Machine configuration for Muse Pi Pro with mainline Linux

require include/k1.inc

KERNEL_DEVICETREE ?= "spacemit/k1-musepi-pro.dtb"

# Muse Pi Pro is not supported yet in mainline U-Boot. Use the BananaPi F3 for
# now, but leave this in the .conf file instead of k1.inc so make it clear it
# needs to change later
UBOOT_MACHINE = "bananapi-f3_defconfig"
```

## conf/machine/nezha-allwinner-d1.conf
```bitbake
#@TYPE: Machine
#@NAME: nezha-allwinner-d1
#@SOC: Allwinner D1
#@DESCRIPTION: Machine configuration for Nezha Allwinner-d1 board

require include/nezha-common.inc

#============================================
# Uboot Configuration
UBOOT_MACHINE = "nezha_defconfig"
UBOOT_DTB_BINARY ?= "sun20i-d1-nezha.dtb"
#============================================
```

## conf/machine/orangepi-rv2-mainline.conf
```bitbake
#@TYPE: Machine
#@NAME: orangepi-rv2-mainline
#@SOC: Spacemit K1
#@DESCRIPTION: Machine configuration for OrangePi RV2 with mainline Linux

require conf/machine/include/k1.inc

KERNEL_DEVICETREE ?= "spacemit/k1-orangepi-rv2.dtb"

# OrangePi RV2 not supported yet in mainline U-Boot. A similar machine works.
UBOOT_MACHINE = "bananapi-f3_defconfig"
```

## conf/machine/qemuriscv32.conf
```bitbake
#@TYPE: Machine
#@NAME: qemuriscv32
#@DESCRIPTION: QEMU RISC-V 32-bit machine

require conf/machine/include/qemu.inc
require conf/machine/include/riscv-common.inc

KERNEL_IMAGETYPE = "Image"
KERNEL_DEFCONFIG = "rv32_defconfig"

QB_SYSTEM_NAME = "qemu-system-riscv32"
QB_MACHINE = "-machine virt"
QB_CPU = "-cpu rv32"
QB_MEM = "-m 2048"
QB_KERNEL_CMDLINE_APPEND = "console=ttyS0"
```

## conf/machine/qemuriscv64.conf
```bitbake
#@TYPE: Machine
#@NAME: generic riscv64 machine
#@DESCRIPTION: Machine configuration for running a generic riscv64

require conf/machine/include/qemuriscv.inc

EXTRA_IMAGEDEPENDS += "u-boot"
UBOOT_MACHINE = "qemu-riscv64_defconfig"
UBOOT_ELF = "u-boot"

PREFERRED_PROVIDER_virtual/kernel = "linux-riscv"
PREFERRED_VERSION_linux-riscv = "4.19%"
```

## conf/machine/riscv64.conf
```bitbake
#@TYPE: Machine
#@NAME: generic riscv64 baremetal machine
#@DESCRIPTION: Machine configuration for running a generic riscv64

DEFAULTTUNE = "riscv64"
require conf/machine/include/qemu.inc
require conf/machine/include/tune-riscv.inc

MACHINE_ARCH = "riscv64"

PREFERRED_VERSION_qemu = "${QEMUVERSION}"
PREFERRED_VERSION_qemu-native = "${QEMUVERSION}"
PREFERRED_VERSION_nativesdk-qemu = "${QEMUVERSION}"

GDBVERSION = "riscv"
QEMUVERSION = "riscv"

# qemuboot options
QB_MACHINE = "-machine virt"
QB_DEFAULT_KERNEL = "bbl"
QB_NETWORK_DEVICE = "-device virtio-net-device,netdev=net0,mac=@MAC@"
QB_ROOTFS_OPT = "-drive file=@ROOTFS@,format=raw,id=hd0 -device virtio-blk-device,drive=hd0"
QB_SLIRP_OPT = "-netdev user,id=net0,hostfwd=tcp::22222-:22"

# Prelink does not yet work

USER_CLASSES_remove = "image-prelink"
# To support baremetal ld complains
# /opt/riscv32/sysroots/x86_64-becsdk-linux/usr/libexec/riscv32-bec-elf/gcc/riscv32-bec-elf/7.3.0/real-ld: unrecognized option '--hash-style=gnu'
#TARGET_LINK_HASH_STYLE = ""
LINKER_HASH_STYLE = ""

TCLIBC = "baremetal"
```

## conf/machine/star64.conf
```bitbake
#@TYPE: Machine
#@NAME: Star64
#@SOC: StarFive JH7110
#@DESCRIPTION: Machine configuration for the Star64 board

require include/jh7110-common.inc

#============================================
# SBI Configuration
RISCV_SBI_FDT ?= "pine64_star64.dtb"
#============================================

#============================================
# Kernel Configuration
KERNEL_DEVICETREE ?= "starfive/jh7110-pine64-star64.dtb"
#============================================

#============================================
# Uboot Configuration
UBOOT_MACHINE = "pine64_star64_defconfig"
UBOOT_DTB_BINARY = "pine64_star64.dtb"
#============================================

#============================================
# Image Configuration
IMAGE_BOOT_FILES = " \
    ${KERNEL_IMAGETYPE}-${INITRAMFS_IMAGE_NAME}-star64;${KERNEL_IMAGETYPE} \
    vf2_uEnv.txt \
"
#============================================
```

## conf/machine/tune-riscv.inc
```bitbake
TUNE_ARCH = "riscv64"

TUNE_PKGARCH = "riscv64"

DEFAULTTUNE ?= "riscv"

# require arch-riscv.inc

TUNEVALID[riscv] = "Enable RISCV optimizations"
TUNE_CCARGS .= ""

AVAILTUNES += "riscv"
TUNE_FEATURES_tune-riscv = "riscv"
TUNE_ARCH_tune-riscv = "riscv"
TUNE_PKGARCH_tune-riscv = "riscv"
PACKAGE_EXTRA_ARCHS_tune-riscv = ""
```

## conf/machine/visionfive2-mainline.conf
```bitbake
#@TYPE: Machine
#@NAME: visionfive2-mainline
#@SOC: StarFive JH7110
#@DESCRIPTION: Machine configuration for the VisionFive 2 board with mainline Linux and U-Boot

require include/visionfive2-common.inc

PREFERRED_PROVIDER_virtual/kernel ?= "linux-mainline-jh7110"
```

## conf/machine/visionfive2.conf
```bitbake
#@TYPE: Machine
#@NAME: visionfive2
#@SOC: StarFive JH7110
#@DESCRIPTION: Machine configuration for the VisionFive 2 board

require include/jh7110-vendor.inc
require include/visionfive2-common.inc
```

## files/wic/beaglev.wks
```
# short-description: Create SD card image for BeagleV Starlight development board

part /boot --source bootimg-partition --ondisk mmcblk0 --fstype=vfat --label boot --active --size=100M --align 4096
part / --source rootfs --ondisk mmcblk0 --fstype=ext4 --label root --align 4096 --size 1G
```

## files/wic/dc-roma-fml13v01.wks
```
# short-description: Create a bootable SD card image for the DC-ROMA RISC-V Mainboard (FML13V01)
# long-description:
# Create a bootable image that can be written onto a SD card using dd for use
# with the DeepComputing DC-ROMA RISC-V Mainboard (FML13V01) in a Framework
# Laptop 13 chassis.
# It uses SPL and u-boot
#
# The disk layout used is:
#  - ----- --------- -------------- --------------
# | | SPL | u-boot  |    boot      |    rootfs    |
#  - ----- --------- -------------- --------------
# ^ ^     ^         ^              ^
# | |     |         |              |
# 0 2MiB  4MiB   8MiB          300MiB + rootfs + IMAGE_EXTRA_SPACE
#
part spl --source rawcopy --sourceparams="file=u-boot-spl.bin.normal.out" --part-name spl --offset 4096S --size 2M --part-type 2E54B353-1271-4842-806F-E436D6AF6985

part uboot --source rawcopy --sourceparams="file=visionfive2_fw_payload.img" --part-name uboot --offset 8192S --size 4M --part-type 5B193300-FC78-40CD-8002-E86C45580B47

# The Fishwaldo Star64 U-Boot fork loads vf2_uEnv.txt and the FIT image
# (starfiveu.fit) directly from the FAT /boot partition.
part /boot --source bootimg-partition --ondisk mmcblk --fstype=vfat --label boot --use-uuid --part-name boot --align 4096 --size 292M

part / --source rootfs --ondisk mmcblk --fstype=ext4 --part-name root --part-type 0FC63DAF-8483-4772-8E79-3D69D8477DE4 --active --label root --align 4096
bootloader  --ptable gpt --timeout 3 --append "console=ttyS0,115200 earlycon=sbi"
```

## files/wic/eswin-ebc77.wks
```
# short-description: Create SD card image for ESWIN Computing EBC77 development board

bootloader --ptable gpt
part /boot --source bootimg-partition --sourceparams="loader=u-boot" --ondisk mmcblk1 --fstype=vfat --label boot --active --fixed-size 128M --align 4096
part / --source rootfs --ondisk mmcblk1 --fstype=ext4 --label root --align 4096 --part-type 72ec70a6-cf74-40e6-bd49-4bda08e8f224 --uuid de0b253f-02fb-4d70-ad0e-6742db4a3883
```

## files/wic/freedom-u540-opensbi-sota.wks
```
# short-description: Create SD card image based on OSTree/OTA+ for HiFive Unleashed development board

part /boot --source bootimg-partition --ondisk mmcblk0 --fstype=vfat --label boot --active --size=100M --align 4096
part opensbi --source rawcopy --sourceparams="file=fw_payload.bin" --ondisk mmcblk0 --size 32M --align 1 --part-type 2e54b353-1271-4842-806f-e436d6af6985
part / --source otaimage --ondisk mmcblk0 --fstype=ext4 --align 4096

bootloader --ptable gpt
```

## files/wic/nezha.wks
```
# short-description: Create SD card image for Nezha Allwinner D1 development board

part u-boot --source rawcopy --sourceparams="file=u-boot-sunxi-with-spl.bin" --offset 16s --ondisk mmcblk0 --no-table
part /boot --source bootimg-partition --ondisk mmcblk0 --fstype=vfat --label boot --align 4096 --fixed-size 64 --active
part /     --source rootfs --ondisk mmcblk0 --fstype=ext4 --label rootfs  --align 4096 --fixed-size 14000 --exclude-path data/
```

## files/wic/orangepi-rv2.wks
```
# Orange Pi RV2 SD Card Layout

part spl      --offset 256K --fixed-size 256K --fstype=none --source rawcopy --sourceparams="file=u-boot-spl.bin"
part uboot    --offset 1M 	--fixed-size 3M   --fstype=none --source rawcopy --sourceparams="file=u-boot-opensbi.itb"

part /boot --ondisk mmcblk0 --fstype=vfat --label boot --offset 4M --size 128M --source bootimg-partition --use-uuid --active --align 4096
part /     --ondisk mmcblk0 --fstype=ext4 --label root --source rootfs --use-uuid --align 4096
```

## files/wic/spacemit-k3.wks
```
# K3 SD Card Image WIC Configuration
# Boot sequence: FSBL → esos → opensbi → u-boot → kernel
# Bootinfo (128 Kbytes) is injected via image-k3.inc post-processing at offset 1M
# Partition layout matches partition_universal.json

bootloader --ptable gpt

part --part-name env --source rawcopy --sourceparams="file=u-boot-env-default.bin" --fixed-size 64K --align 640

part --part-name fsbl --source rawcopy --sourceparams="file=FSBL.bin" --fixed-size 512K --align 1536

part --part-name esos --source rawcopy --sourceparams="file=esos.itb" --fixed-size 3M --align 4096

part --part-name opensbi --source rawcopy --sourceparams="file=fw_dynamic.itb" --fixed-size 1M --align 7168

part --part-name uboot --source rawcopy --sourceparams="file=u-boot.itb" --fixed-size 4M --align 8192

part --part-name bootfs --source rawcopy --sourceparams="file=bootfs.ext4" --fixed-size 256M --align 12288

part --part-name rootfs --source rootfs --fstype=ext4 --label rootfs --align 274432
```

## recipes-bsp/u-boot/boot-bundle/k1/boot-bundle.its
```
/dts-v1/;

/ {
        description = "Configuration to load OpenSBI before U-Boot";
        #address-cells = <0x02>;

        images {

                uboot {
                        description = "U-Boot";
                        type = "standalone";
                        os = "U-Boot";
                        arch = "riscv";
                        compression = "none";
                        load = <0x00 0x200000>;
                        data = /incbin/("u-boot-nodtb.bin");
                };

                opensbi {
                        description = "OpenSBI fw_dynamic Firmware";
                        type = "firmware";
                        os = "opensbi";
                        arch = "riscv";
                        compression = "none";
                        load = <0x00 0x00>;
                        entry = <0x00 0x00>;
                        data = /incbin/("fw_dynamic.bin");
                };

                fdt-1 {
                        description = "U-Boot Device Tree";
                        type = "flat_dt";
                        compression = "none";
                        offset = <0x00>;
                        size = <0x00>;
                        image-pos = <0x00>;
                        data = /incbin/("u-boot.dtb");
                };

                kernel-1 {
                        description = "Linux kernel";
                        data = /incbin/("Image");
                        type = "kernel";
                        arch = "riscv";
                        os = "linux";
                        compression = "none";
                        load = <0x2000000>;
                        entry = <0x2000000>;
                };

                fdt-2 {
                        description = "Flattened Device Tree blob";
                        data = /incbin/("KERNEL_DEVICETREE");
                        type = "flat_dt";
                        arch = "riscv";
                        compression = "none";
                        load = <0x5000000>;
                };

        };

        configurations {
                default = "conf-1";

                conf-1 {
                        description = "SpacemiT K1 based board";
                        firmware = "opensbi";
                        loadables = "uboot", "kernel-1", "fdt-2";
                        fdt = "fdt-1";
                };
        };
};
```
